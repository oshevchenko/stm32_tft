#include "main.h"
#include "stm32f1xx_hal.h"
#include "lcd.h"
#define ResetPin
#define ResetPort

void LCDHardwareReset()
{
	HAL_GPIO_WritePin(GPIO_LCD_RST_GPIO_Port, GPIO_LCD_RST_Pin, GPIO_PIN_RESET);
	HAL_Delay(50);
	HAL_GPIO_WritePin(GPIO_LCD_RST_GPIO_Port, GPIO_LCD_RST_Pin, GPIO_PIN_SET);
	HAL_Delay(10);
}

void LCDSetBounds(uint16_t left, uint16_t top, uint16_t right, uint16_t bottom)
{
   LCD_WRITE_REGISTER(CTR_VERT_START, left);
   LCD_WRITE_REGISTER(CTR_VERT_END, right);
   LCD_WRITE_REGISTER(CTR_HORZ_START, top);
   LCD_WRITE_REGISTER(CTR_HORZ_END, bottom);

   LCD_WRITE_REGISTER(CTR_HORZ_ADDRESS, top);
   LCD_WRITE_REGISTER(CTR_VERT_ADDRESS, left);
}

void LCDOn()
{
	 LCD_WRITE_REGISTER(CTR_DISPLAY1, 0x0133);
}

 void LCDOff()
{
	 LCD_WRITE_REGISTER(CTR_DISPLAY1, 0x0131);
}

void LCDClear(uint16_t color)
{
	LCDSetBounds(0,0,320-1,240-1);
  	LCD_BEGIN_RAM_WRITE;
  	uint32_t i;
  	for(i=0;i<320*240;i++)
  		LCD_WRITE_RAM(color);
}
void LCDUaFlag()
{
	LCDSetBounds(0,0,320-1,240-1);
  	LCD_BEGIN_RAM_WRITE;
  	uint32_t i;
  	for(i=0;i<320*240/2;i++)
  		LCD_WRITE_RAM(0x041F);
  	for(i=0;i<320*240/2;i++)
  		LCD_WRITE_RAM(0xFFE0);
}
// Blue - 0x041F
// Yellow - 0xFFE0


void LCDInit()
{
	LCDHardwareReset();
	LCD_WRITE_REGISTER(CTR_OSC_START, 0x0001);
	LCD_WRITE_REGISTER(CTR_DRV_OUTPUT1, 0x0100);
	LCD_WRITE_REGISTER(CTR_DRV_WAVE, 0x0700);
	LCD_WRITE_REGISTER(CTR_ENTRY_MODE, 0x1038);
	LCD_WRITE_REGISTER(CTR_RESIZE, 0x0000);
	LCD_WRITE_REGISTER(CTR_DISPLAY2, 0x0202);
	LCD_WRITE_REGISTER(CTR_DISPLAY3, 0x0000);
	LCD_WRITE_REGISTER(CTR_DISPLAY4, 0x0000);
	LCD_WRITE_REGISTER(CTR_RGB_INTERFACE1, 0x0001);
	LCD_WRITE_REGISTER(CTR_FRM_MARKER, 0x0000);
	LCD_WRITE_REGISTER(CTR_RGB_INTERFACE2, 0x0000);

	LCD_WRITE_REGISTER(CTR_POWER1, 0x0000);
	LCD_WRITE_REGISTER(CTR_POWER2, 0x0007);
	LCD_WRITE_REGISTER(CTR_POWER3, 0x0000);
	LCD_WRITE_REGISTER(CTR_POWER4, 0x0000);

	HAL_Delay(200);

	LCD_WRITE_REGISTER(CTR_POWER1, 0x1590);
	LCD_WRITE_REGISTER(CTR_POWER2, 0x0227);

	HAL_Delay(50);

	LCD_WRITE_REGISTER(CTR_POWER3, 0x009C);

	HAL_Delay(50);

	LCD_WRITE_REGISTER(CTR_POWER4, 0x1900);
	LCD_WRITE_REGISTER(CTR_POWER7, 0x1900);
	LCD_WRITE_REGISTER(CTR_FRM_COLOR, 0x000E);

	HAL_Delay(50);

	LCD_WRITE_REGISTER(CTR_HORZ_ADDRESS, 0x0000);
	LCD_WRITE_REGISTER(CTR_VERT_ADDRESS, 0x0000);

	LCD_WRITE_REGISTER(CTR_HORZ_START, 0x0000);
	LCD_WRITE_REGISTER(CTR_HORZ_END, 239);
	LCD_WRITE_REGISTER(CTR_VERT_START, 0x0000);
	LCD_WRITE_REGISTER(CTR_VERT_END, 319);

	LCD_WRITE_REGISTER(CTR_DRV_OUTPUT2, 0x2700);
	LCD_WRITE_REGISTER(CTR_BASE_IMAGE, 0x0001);
	LCD_WRITE_REGISTER(CTR_VERT_SCROLL, 0x0000);

}
